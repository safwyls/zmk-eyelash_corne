## boards/shields/eyelash_corne_dongle/Kconfig.defconfig
```kconfig
# Copyright (c) 2024 The ZMK Contributors
# SPDX-License-Identifier: MIT

if SHIELD_EYELASH_CORNE_DONGLE

config ZMK_KEYBOARD_NAME
    default "Eyelash Corne"

config ZMK_SPLIT_ROLE_CENTRAL
    default y

config ZMK_SPLIT
    default y

config ZMK_SPLIT_BLE_CENTRAL_PERIPHERALS
    default 2

# Dongle needs connections for 2 peripherals + BT profiles
config BT_MAX_CONN
    default 7

config BT_MAX_PAIRED
    default 7

endif
```

## boards/shields/eyelash_corne_dongle/Kconfig.shield
```kconfig
# Copyright (c) 2024 The ZMK Contributors
# SPDX-License-Identifier: MIT

config SHIELD_EYELASH_CORNE_DONGLE
    def_bool $(shields_list_contains,eyelash_corne_dongle)
```
